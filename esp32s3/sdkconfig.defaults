## esp32s3/sdkconfig.defaults
```kconfig
# Build-smoke config for the SuperSonic engine on ESP32-S3 (ESP32-S3R8: 8 MB
# octal PSRAM, 16 MB flash). The load-bearing settings exercise the embedded
# constraints in CI; the rest mirror a realistic real-time host.

# --- Target ---
CONFIG_IDF_TARGET="esp32s3"

# --- CPU / RTOS ---
CONFIG_ESP_DEFAULT_CPU_FREQ_MHZ_240=y
CONFIG_FREERTOS_HZ=1000

# --- Console over native USB-Serial-JTAG (so a run, on-device or emulated,
#     prints the smoke result without UART pins) ---
CONFIG_ESP_CONSOLE_USB_SERIAL_JTAG=y

# --- PSRAM: 8 MB octal @ 80 MHz. ALLOW_BSS_SEG_EXTERNAL_MEMORY is what lets the
#     engine's SC_COLD_BSS (EXT_RAM_BSS_ATTR) ring arena + schedulers link into
#     PSRAM — the placement this CI guard exists to validate. ---
CONFIG_SPIRAM=y
CONFIG_SPIRAM_MODE_OCT=y
CONFIG_SPIRAM_SPEED_80M=y
CONFIG_SPIRAM_USE_MALLOC=y
CONFIG_SPIRAM_BOOT_INIT=y
CONFIG_SPIRAM_ALLOW_BSS_SEG_EXTERNAL_MEMORY=y
CONFIG_SPIRAM_MALLOC_ALWAYSINTERNAL=0

# --- Flash: 16 MB, custom partition table (the engine is a big static binary,
#     so the default app partition is too small to link). ---
CONFIG_ESPTOOLPY_FLASHSIZE_16MB=y
CONFIG_PARTITION_TABLE_CUSTOM=y
CONFIG_PARTITION_TABLE_CUSTOM_FILENAME="partitions.csv"

# --- C++: scsynth uses throw/catch and a little RTTI ---
CONFIG_COMPILER_CXX_EXCEPTIONS=y
CONFIG_COMPILER_CXX_RTTI=y

# --- Disable assertions (defines NDEBUG): scsynth's AllocPool DoCheck* debug
#     helpers reference locals that only exist when assert() is a no-op ---
CONFIG_COMPILER_OPTIMIZATION_ASSERTIONS_DISABLE=y

# --- Optimize for performance (-O2): nova-simd's template unrollers and the UGen
#     calc loops only collapse to tight code under real optimization ---
CONFIG_COMPILER_OPTIMIZATION_PERF=y

# --- Bigger main task stack: scsynth's small_scpacket is an 8 KB stack object ---
CONFIG_ESP_MAIN_TASK_STACK_SIZE=32768

# --- Power management off: DFS jitter wrecks a real-time audio task ---
CONFIG_PM_ENABLE=n
```
